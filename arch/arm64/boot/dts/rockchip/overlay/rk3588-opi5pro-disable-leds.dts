/dts-v1/;
/plugin/;

/ {
	fragment@0 {
		target = <&leds>;

		__overlay__ {
			status = "okay";

			blue_led@1 {
				default-state = "off";
				linux,default-trigger = "none";
			};

			green_led@2 {
				default-state = "off";
				linux,default-trigger = "none";
			};
		};
	};
};
